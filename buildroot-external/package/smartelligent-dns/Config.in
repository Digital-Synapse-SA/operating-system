## buildroot-external/package/smartelligent-dns/Config.in
```kconfig
menuconfig BR2_PACKAGE_SMARTELLIGENT_DNS
	bool "Smartelligent DNS"
	help
	  Smartelligent DNS service using dnsmasq for local
	  DNS resolution and device discovery.

	  https://github.com/Digital-Synapse-SA/dns

if BR2_PACKAGE_SMARTELLIGENT_DNS

config BR2_PACKAGE_SMARTELLIGENT_DNS_CONFIG
	string "DNS Configuration"
	default "smartelligent-dns.conf"
	help
	  Configuration file for Smartelligent DNS service.

endif 
```
